## arch/mips/mach-mtmips/mt7621/Kconfig
```kconfig
if SOC_MT7621

config DEBUG_UART_BOARD_INIT
	default y

choice
	prompt "Board select"

config BOARD_MT7621_RFB
	bool "MediaTek MT7621 RFB (SPI-NOR)"
	help
	  The reference design of MT7621A (WS3010) booting from SPI-NOR flash.
	  The board can be configured with DDR2 (64MiB~256MiB) or DDR3
	  (128MiB~512MiB). The board has 16 MiB SPI-NOR flash, built-in MT7530
	  GbE switch, 1 UART, 1 USB 2.0 host, 1 USB 3.0 host, 1 SDXC, 3 PCIe
	  sockets, 1 RGMII to external GbE PHY, 2 audio jacks (in/out),
	  JTAG pins and expansion GPIO pins.

config BOARD_MT7621_NAND_RFB
	bool "MediaTek MT7621 RFB (NAND)"
	help
	  The reference design of MT7621A (WS3010) booting from NAND flash.
	  The board can be configured with DDR2 (64MiB~256MiB) or DDR3
	  (128MiB~512MiB). The board has 128 MiB parallel NAND flash, built-in
	  MT7530 GbE switch, 1 UART, 1 USB 2.0 host, 1 USB 3.0 host, 3 PCIe
	  sockets, 1 RGMII to external GbE PHY, 2 audio jacks (in/out),
	  JTAG pins and expansion GPIO pins.

endchoice

config SYS_CONFIG_NAME
	string "Board configuration name"
	default "mt7621" if  BOARD_MT7621_RFB || BOARD_MT7621_NAND_RFB

config SYS_BOARD
	string "Board name"
	default "mt7621" if  BOARD_MT7621_RFB || BOARD_MT7621_NAND_RFB

config SYS_VENDOR
	default "mediatek" if BOARD_MT7621_RFB || BOARD_MT7621_NAND_RFB

endif
```

## configs/mercusys_mr70x_defconfig
```kconfig
CONFIG_MIPS=y
CONFIG_SYS_CONFIG_NAME="mr70x"
CONFIG_NR_DRAM_BANKS=1
CONFIG_ENV_SIZE=0x1000
CONFIG_SYS_MALLOC_LEN=0x100000
CONFIG_DEFAULT_DEVICE_TREE="mercusys,mr70x"
CONFIG_DEBUG_UART_BASE=0xbe000c00
CONFIG_DEBUG_UART_CLOCK=50000000
CONFIG_ARCH_MTMIPS=y
CONFIG_SOC_MT7621=y
# CONFIG_MIPS_CACHE_SETUP is not set
# CONFIG_MIPS_CACHE_DISABLE is not set
CONFIG_RESTORE_EXCEPTION_VECTOR_BASE=y
CONFIG_SPL_INIT_STACK_WITHOUT_MALLOC_F=y
CONFIG_MIPS_BOOT_FDT=y
CONFIG_DEBUG_UART=y
CONFIG_SYS_LOAD_ADDR=0x81001000
CONFIG_FIT=y
# CONFIG_ARCH_FIXUP_FDT_MEMORY is not set
CONFIG_SYS_CONSOLE_INFO_QUIET=y
# CONFIG_BOOTM_NETBSD is not set
# CONFIG_BOOTM_PLAN9 is not set
# CONFIG_BOOTM_RTEMS is not set
# CONFIG_BOOTM_VXWORKS is not set
# CONFIG_CMD_ELF is not set
# CONFIG_CMD_XIMG is not set
# CONFIG_CMD_CRC32 is not set
# CONFIG_CMD_DM is not set
CONFIG_CMD_GPIO=y
# CONFIG_CMD_LOADS is not set
# CONFIG_CMD_MMC is not set
CONFIG_CMD_PART=y
# CONFIG_CMD_PINMUX is not set
CONFIG_CMD_SPI=y
CONFIG_CMD_USB=y
# CONFIG_CMD_NFS is not set
# CONFIG_CMD_FAT is not set
CONFIG_CMD_FS_GENERIC=y
# CONFIG_ISO_PARTITION is not set
CONFIG_EFI_PARTITION=y
CONFIG_PARTITION_TYPE_GUID=y
CONFIG_SYS_RELOC_GD_ENV_ADDR=y
CONFIG_NET_RANDOM_ETHADDR=y
# CONFIG_I2C is not set
# CONFIG_INPUT is not set
# CONFIG_MMC is not set
# CONFIG_MMC_QUIRKS is not set
# CONFIG_MMC_HW_PARTITIONING is not set
# CONFIG_MMC_MTK is not set
CONFIG_SPI_FLASH_EON=y
CONFIG_SPI_FLASH_GIGADEVICE=y
CONFIG_SPI_FLASH_ISSI=y
CONFIG_SPI_FLASH_MACRONIX=y
CONFIG_SPI_FLASH_SPANSION=y
CONFIG_SPI_FLASH_STMICRO=y
CONFIG_SPI_FLASH_WINBOND=y
CONFIG_SPI_FLASH_XMC=y
CONFIG_MEDIATEK_ETH=y
CONFIG_PHY=y
CONFIG_PHY_MTK_TPHY=y
CONFIG_SPECIFY_CONSOLE_INDEX=y
CONFIG_DEBUG_UART_SHIFT=2
CONFIG_SPI=y
CONFIG_MT7621_SPI=y
CONFIG_SYSRESET=y
CONFIG_SYSRESET_RESETCTL=y
# CONFIG_USB is not set
# CONFIG_USB_XHCI_HCD is not set
# CONFIG_USB_XHCI_MTK is not set
# CONFIG_USB_STORAGE is not set
CONFIG_WDT=y
CONFIG_WDT_MT7621=y
# CONFIG_FAT_WRITE is not set
CONFIG_LZMA=y
CONFIG_SPL_LZMA=y
```

## configs/mt7621_nand_rfb_ramboot_defconfig
```kconfig
CONFIG_MIPS=y
CONFIG_SYS_CONFIG_NAME="mt7621-rfb"
CONFIG_NR_DRAM_BANKS=1
CONFIG_ENV_SIZE=0x1000
CONFIG_SYS_MALLOC_LEN=0x100000
CONFIG_DEFAULT_DEVICE_TREE="mediatek,mt7621-nand-rfb"
CONFIG_DEBUG_UART_BASE=0xbe000c00
CONFIG_DEBUG_UART_CLOCK=50000000
CONFIG_ARCH_MTMIPS=y
CONFIG_SOC_MT7621=y
CONFIG_BOARD_MT7621_NAND_RFB=y
# CONFIG_MIPS_CACHE_SETUP is not set
# CONFIG_MIPS_CACHE_DISABLE is not set
CONFIG_RESTORE_EXCEPTION_VECTOR_BASE=y
CONFIG_SPL_INIT_STACK_WITHOUT_MALLOC_F=y
CONFIG_MIPS_BOOT_FDT=y
CONFIG_DEBUG_UART=y
CONFIG_SYS_LOAD_ADDR=0x83000000
CONFIG_FIT=y
# CONFIG_ARCH_FIXUP_FDT_MEMORY is not set
CONFIG_SYS_CONSOLE_INFO_QUIET=y
# CONFIG_BOOTM_NETBSD is not set
# CONFIG_BOOTM_PLAN9 is not set
# CONFIG_BOOTM_RTEMS is not set
# CONFIG_BOOTM_VXWORKS is not set
# CONFIG_CMD_ELF is not set
# CONFIG_CMD_XIMG is not set
# CONFIG_CMD_CRC32 is not set
# CONFIG_CMD_DM is not set
# CONFIG_CMD_FLASH is not set
CONFIG_CMD_GPIO=y
# CONFIG_CMD_LOADS is not set
CONFIG_CMD_MMC=y
CONFIG_CMD_MTD=y
CONFIG_CMD_PART=y
# CONFIG_CMD_PINMUX is not set
CONFIG_CMD_USB=y
# CONFIG_CMD_NFS is not set
CONFIG_CMD_FAT=y
CONFIG_CMD_FS_GENERIC=y
# CONFIG_ISO_PARTITION is not set
CONFIG_EFI_PARTITION=y
CONFIG_PARTITION_TYPE_GUID=y
CONFIG_SYS_RELOC_GD_ENV_ADDR=y
CONFIG_NET_RANDOM_ETHADDR=y
# CONFIG_I2C is not set
# CONFIG_INPUT is not set
CONFIG_MMC=y
# CONFIG_MMC_QUIRKS is not set
# CONFIG_MMC_HW_PARTITIONING is not set
CONFIG_MMC_MTK=y
CONFIG_MTD=y
CONFIG_DM_MTD=y
CONFIG_MTD_RAW_NAND=y
CONFIG_NAND_MT7621=y
CONFIG_SYS_NAND_ONFI_DETECTION=y
CONFIG_MEDIATEK_ETH=y
CONFIG_PHY=y
CONFIG_PHY_MTK_TPHY=y
CONFIG_SPECIFY_CONSOLE_INDEX=y
CONFIG_DEBUG_UART_SHIFT=2
CONFIG_SYSRESET=y
CONFIG_SYSRESET_RESETCTL=y
CONFIG_USB=y
CONFIG_USB_XHCI_HCD=y
CONFIG_USB_XHCI_MTK=y
CONFIG_USB_STORAGE=y
CONFIG_WDT=y
CONFIG_WDT_MT7621=y
CONFIG_FAT_WRITE=y
CONFIG_LZMA=y
CONFIG_SPL_LZMA=y
```
